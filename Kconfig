## Kconfig
```kconfig
#
# Copyright (c) 2022 Laird Connectivity
#
# SPDX-License-Identifier: Apache-2.0
#

config JSMN
	bool "JSMN (JSON C parser)"
	help
	  Select this to enable the JSMN library, a minimalistic JSON parser

if JSMN

config JSMN_NUMBER_OF_TOKENS
	int "The number of tokens for jsmn"
	default 512
	help
	  JSMN is used to process shadow and CoAP messages.
	  The maximum size of the shadow (and tokens required) is affected
	  by the number of sensors and the sensor log size.
	  The timestamps that are generated by AWS make the shadow large.

# Include logging configuration
module = JSMN
module-str = JSMN
source "subsys/logging/Kconfig.template.log_config"

endif # JSMN
```
